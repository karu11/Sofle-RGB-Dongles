## boards/shields/sofle/Kconfig.defconfig
```kconfig
# Copyright (c) 2020 Ryan Cross
# SPDX-License-Identifier: MIT

if SHIELD_SOFLE_DONGLE

config ZMK_KEYBOARD_NAME
    default "Snake"

config ZMK_SPLIT_ROLE_CENTRAL
    default y

config ZMK_SPLIT_BLE_CENTRAL_PERIPHERALS
    default 2

config BT_MAX_CONN
    default 6

config BT_MAX_PAIRED
    default 6

endif  # dongle

if SHIELD_SOFLE_LEFT || SHIELD_SOFLE_RIGHT

config BOARD
    default "Snake"

config BOARD_ENABLE_DCDC
    bool "Enable DCDC mode"
    select SOC_DCDC_NRF52X
    default y
    depends on (SHIELD_SOFLE_LEFT || SHIELD_SOFLE_RIGHT)

config BOARD_ENABLE_DCDC_HV
    bool "Enable High Voltage DCDC converter"
    default y
    select SOC_DCDC_NRF52X_HV
    depends on (SHIELD_SOFLE_LEFT || SHIELD_SOFLE_RIGHT)

config ZMK_SPLIT
    default y

config BT_CTLR
    default BT

if SSD1306

config LV_Z_VDB_SIZE
   default 64

config LV_DPI_DEF
    default 148

config LV_Z_BITS_PER_PIXEL
    default 1

choice LV_COLOR_DEPTH
    default LV_COLOR_DEPTH_1
endchoice

endif # USB

if ZMK_DISPLAY

config I2C
   default y

config SSD1306
    default y

choice ZMK_DISPLAY_WORK_QUEUE
    default ZMK_DISPLAY_WORK_QUEUE_DEDICATED
endchoice

endif #zmk display

endif 
```
